VERSION "HIPBNYYYYYYYYYYYYYYYYYYYYYYYYYYYYYYYYYYYYY/4/%%%/4/'%**4YYY///"

NS_ :

BS_:

BU_: CAS

BO_ 304 KLEMMENSTATUS: 5 CAS
 SG_ ALIV_KL m0 : 32|4@1+ (1,0) [0|14] "" CAS
 SG_ CHKSM_KL m0 : 36|4@1+ (1,0) [0|15] "" CAS

BA_DEF_  "BusType" STRING ;
BA_DEF_DEF_  "BusType" "";
BA_ "BusType" "CAN";
