VERSION ""

NS_ :

BS_:
BU_: CAS
BO_ 304 KLEMMENSTATUS: 5 CAS
   SG_ ALIV_KL : 32|4@1+ (1,0) [0|0] "" CAS
   SG_ CHKSM_KL : 36|4@1+ (1,0) [0|0] "" CAS

BA_DEF_ BO_ "GenMsgBackgroundColor" STRING ;
BA_DEF_ BO_ "GenMsgForegroundColor" STRING ;
BA_DEF_DEF_ "GenMsgBackgroundColor" "#ffffff";
BA_DEF_DEF_ "GenMsgForegroundColor" "#000000";
